## Kconfig
```kconfig
menu "HUB75 RGB Panel"

config HUB75
    bool "HUB75 LED Panel Display Controller"
    depends on DT_HAS_ZEPHYR_HUB75_ENABLED
    select DISPLAY
    select GPIO
    select COUNTER
    help
      HUB75 LED panel controller.

endmenu
```

## dts/bindings/display/zephyr,hub75.yaml
```yaml
# Copyright 2026, Evan Stoddard
# SPDX-License-Identifier: Apache-2.0

description: HUB75 RGB LED Panel Display Controller

compatible: "zephyr,hub75"

include: display-controller.yaml

properties:

  pin-r1-gpios:
    type: phandle-array
    required: true
    description: Red bit for top half 
  
  pin-r2-gpios:
    type: phandle-array
    required: true
    description: Red bit for lower half 

  pin-g1-gpios:
    type: phandle-array
    required: true
    description: Green bit for top half 

  pin-g2-gpios:
    type: phandle-array
    required: true
    description: Green bit for lower half 

  pin-b1-gpios:
    type: phandle-array
    required: true
    description: Blue bit for top half 

  pin-b2-gpios:
    type: phandle-array
    required: true
    description: Blue bit for lower half 

  pin-a-gpios:
    type: phandle-array
    required: true
    description: Row address bit 0

  pin-b-gpios:
    type: phandle-array
    required: true
    description: Row address bit 1

  pin-c-gpios:
    type: phandle-array
    required: true
    description: Row address bit 2
  
  pin-d-gpios:
    type: phandle-array
    required: true
    description: Row address bit 3

  pin-e-gpios:
    type: phandle-array
    required: true
    description: Row address bit 4

  pin-clk-gpios:
    type: phandle-array
    required: true
    description: Clock line 

  pin-latch-gpios:
    type: phandle-array
    required: true
    description: Latch line 

  pin-n-en-gpios:
    type: phandle-array
    required: true
    description: Output enable line 

  counter:
    type: phandle
    required: true
    description: Hardware counter used to drive the refresh ISR.

  width:
    type: int
    required: true
    description: |
      Display width in pixels.

  height:
    type: int
    required: true
    description: |
      Display height in pixels.
```
